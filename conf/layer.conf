## conf/layer.conf
```bitbake
# -*- mode: Conf; -*-
# We have a conf and classes directory, add to BBPATH
BBPATH .= ":${LAYERDIR}"

# We have recipes-* directories, add to BBFILES
BBFILES += "${LAYERDIR}/amp-benchmark-demo/amp-benchmark-demo.bb \
            ${LAYERDIR}/recipes-*/*/*.bb \
            ${LAYERDIR}/recipes-*/*/*.bbappend"

BBFILE_COLLECTIONS += "meta-amp-benchmark"
BBFILE_PATTERN_meta-amp-benchmark = "^${LAYERDIR}/"
BBFILE_PRIORITY_meta-aws = "6"

LAYERDEPENDS_meta-amp-benchmark += "core"
LAYERDEPENDS_meta-amp-benchmark += "openembedded-layer"
LAYERDEPENDS_meta-amp-benchmark += "meta-ti"
LAYERDEPENDS_meta-amp-benchmark += "meta-arago"

LAYERSERIES_COMPAT_meta-amp-benchmark = "dunfell"
```
